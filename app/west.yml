## app/west.yml
```yaml
manifest:
  remotes:
    - name: zephyrproject
      url-base: https://github.com/zephyrproject-rtos

  projects:
    - name: zephyr
      remote: zephyrproject
      revision: zephyr-v2.6.0
      import: true

  self:
    path: app
```

## build/Kconfig/Kconfig.shield.defconfig
```kconfig
osource "/home/tuan.nguyen1/Persional_file/Zephyr/zephyr/boards/shields/*/Kconfig.defconfig"
```

## build/Kconfig/Kconfig.soc
```kconfig
osource "/home/tuan.nguyen1/Persional_file/Zephyr/zephyr/soc/$(ARCH)/*/Kconfig.soc"
```

## build/Kconfig/Kconfig.soc.arch
```kconfig
osource "/home/tuan.nguyen1/Persional_file/Zephyr/zephyr/soc/$(ARCH)/Kconfig"
osource "/home/tuan.nguyen1/Persional_file/Zephyr/zephyr/soc/$(ARCH)/*/Kconfig"
```
